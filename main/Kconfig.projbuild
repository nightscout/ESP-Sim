## main/Kconfig.projbuild
```kconfig
menu "ESP-Sim"

config ESPSIM_TZ
    string "Time zone (POSIX TZ)"
    default "UTC0"
    help
        The pod reports its activation date and time in this zone, as a
        real pod reports the PDM's local time. Example: "CST6CDT,M3.2.0,M11.1.0".

config ESPSIM_AP_SSID_PREFIX
    string "Access point name prefix"
    default "ESP-Sim-Pod"
    help
        With no Wi-Fi network saved, the board runs an access point named
        this plus the end of its MAC address. Its password is
        ESPSIM_AP_PASSWORD.

config ESPSIM_AP_PASSWORD
    string "Access point password"
    default "esp-sim-pod"
    help
        The password of the board's own access point: 8 to 16 characters
        (WPA2). The same on every board built with it, and in the README:
        it keeps strangers from joining by accident, it is not a secret.

config ESPSIM_CGM_BACKTEST
    bool "CGM backtest mode"
    default y
    help
        A third way for the simulated CGM to make glucose, beside the
        virtual person and a fixed value: replay a trace uploaded on the
        CGM page, reading by reading, whatever the pump does, and log what
        the pump did against each reading, to compare two builds of an AID
        algorithm on the same glucose. The trace and the log go in the
        "backtest" flash partition (partitions.csv); a board whose
        partition table predates it (updated only over Wi-Fi) keeps a
        smaller trace and log in RAM, lost on a restart.
        Off: the CGM page shows no backtest mode, and the board keeps no
        trace.

choice ESPSIM_MEDTRUM_MODEL
    prompt "Default Medtrum model"
    default ESPSIM_MEDTRUM_200
    help
        The base serial a fresh Medtrum simulation starts with. The control
        panel can pivot it later without a rebuild.

config ESPSIM_MEDTRUM_200
    bool "200U (serial 4A12D828)"

config ESPSIM_MEDTRUM_300
    bool "300U (serial 52DF1614)"

endchoice

endmenu
```
